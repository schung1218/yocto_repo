## meta-nua3500/conf/distro/nuvoton-nua3500-fb.conf
```bitbake
# NUA3500 DISTRO for the FrameBuffer graphical backend.

DISTRO = "nuvoton-nua3500"
DISTRO_NAME = "Nuvoton Release Distro"
DISTRO_VERSION = "5.5-dunfell"

DISTRO_CODENAME = "dunfell"
SDK_VENDOR = "-pokysdk"
SDK_VERSION := "${DISTRO_VERSION}"

MAINTAINER = "Nuvoton <www.nuvoton.com>"

TARGET_VENDOR = "-poky"

DISTRO = "nuvoton-nua3500-fb"

# Remove conflicting backends.
DISTRO_FEATURES_append = "directfb virtualization"
```

## meta-nua3500/conf/distro/nvt-nua3500-fb.conf
```bitbake
# NUA3500 DISTRO for the FrameBuffer graphical backend.

DISTRO = "nvt-nua3500"
DISTRO_NAME = "Nuvoton Release Distro"
DISTRO_VERSION = "5.5-dunfell"

DISTRO_CODENAME = "dunfell"
SDK_VENDOR = "-pokysdk"
SDK_VERSION := "${DISTRO_VERSION}"

MAINTAINER = "Nuvoton <www.nuvoton.com>"

TARGET_VENDOR = "-poky"

DISTRO = "nvt-nua3500-fb"

# Remove conflicting backends.
DISTRO_FEATURES_append = "directfb virtualization"
```

## meta-nua3500/conf/machine/nua3500evb.conf
```bitbake
#@TYPE: Machine
#@NAME: nua3500
#@DESCRIPTION: Configuration for all NUA3500 boards (EV, DK, ...)
#@NEEDED_BSPLAYERS: layers/meta-openembedded/meta-oe layers/meta-openembedded/meta-python


MACHINEOVERRIDES = "nua3500:nua3500evb"



# =========================================================================
# Chip architecture
# =========================================================================
DEFAULTTUNE = "cortexa35"
DEFAULTTUNE_nua3500 = "cortexa35"
include conf/machine/include/tune-cortexa35.inc

# =========================================================================
# Kernel
# =========================================================================
PREFERRED_PROVIDER__kernel = "linux-nua3500"
PREFERRED_PROVIDER_virtual/kernel = "linux-nua3500"
KERNEL_DEVICETREE = "nuvoton/nua3500-evb.dtb"

# =========================================================================
# u-boot
# =========================================================================
PREFERRED_PROVIDER_u-boot = "u-boot-nua3500"
PREFERRED_PROVIDER_virtual/bootloader = "u-boot-nua3500"
#UBOOT_CONFIG ??= "ram"
UBOOT_CONFIG ??= "sdcard"
UBOOT_CONFIG[ram] = "imx8qxp_mek_defconfig"
UBOOT_CONFIG[sdcard] = "imx8qxp_mek_defconfig"

EXTRA_IMAGEDEPENDS += "virtual/bootloader"
# =========================================================================
# trusted-firmware-a
# =========================================================================
PREFERRED_PROVIDER_virtual/trusted-firmware-a = "tf-a-nua3500"
EXTRA_IMAGEDEPENDS += "virtual/trusted-firmware-a"
# =========================================================================
# optee-os
# =========================================================================
PREFERRED_PROVIDER_virtual/optee-os = "optee-os-nua3500"
EXTRA_IMAGEDEPENDS += "virtual/optee-os"

# =========================================================================
# fs
# =========================================================================
IMAGE_FSTYPES = "ext2 ram"

IMAGE_CLASSES = "image_types_nvt"


# Disable the serial console due to auto-serial-console
SERIAL_CONSOLES = "115200;ttyS0"

# we do not want to have getty running on tty1 as we run
# auto-serial-console there
USE_VT = "0"
```
